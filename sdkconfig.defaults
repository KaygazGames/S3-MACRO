## sdkconfig.defaults
```kconfig
CONFIG_IDF_TARGET="esp32s3"
CONFIG_ESP32S3_USB_SERIAL_JTAG_SUPPORT=y
CONFIG_USB_OTG_SUPPORTED=y
CONFIG_BT_ENABLED=y
CONFIG_BT_NIMBLE_ENABLED=y
CONFIG_USB_HOST_ENABLED=y
```
